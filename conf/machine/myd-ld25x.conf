## conf/machine/myd-ld25x.conf
```bitbake
#@TYPE: Machine
#@NAME: stm32mp2
#@DESCRIPTION: Configuration for all STM32MP2 boards (EV, DK, ...)
#@NEEDED_BSPLAYERS: layers/meta-openembedded/meta-oe layers/meta-openembedded/meta-python

# Define specific familly common machine name
MACHINEOVERRIDES =. "stm32mp2common:stm32mp25common:stm32mp23common:stm32mp21common:"

include conf/machine/include/st-machine-common-stm32mp.inc
include conf/machine/include/st-machine-providers-stm32mp.inc

MACHINENAME="myd-ld25x"

# =========================================================================
# Chip architecture
# =========================================================================
DEFAULTTUNE = "cortexa35"
include conf/machine/include/arm/armv8a/tune-cortexa35.inc

PREFERRED_PROVIDER_u-boot-fw-utils:stm32mp2common = "libubootenv"

MACHINE_EXTRA_RRECOMMENDS:append:stm32mp2common = " \
    u-boot-fw-config-stm32mp \
"
# =========================================================================
# boot scheme
# =========================================================================
BOOTSCHEME_LABELS = "optee"
BOOTSCHEME_LABELS += "opteemin"
BOOTSCHEME_LABELS += "fastboot"
BOOTSCHEME_LABELS += "fastboot-opteemin"
#uboot config
#BOOT_SELECT = "1"
#UBOOT_CONFIG:append:stm32mp25common = " ${@bb.utils.contains('BOOTSELECT', '1', 'default_2G', '', d)} "
#UBOOT_CONFIG:append:stm32mp25common = " ${@bb.utils.contains('BOOTSELECT', '0', 'default_1G', '', d)} "

# =========================================================================
# boot device
# =========================================================================
# Define the boot device supported
BOOTDEVICE_LABELS += "emmc"
#BOOTDEVICE_LABELS += "nand-4-256-1024"
BOOTDEVICE_LABELS += "nor-sdcard"
BOOTDEVICE_LABELS += "sdcard"

IMAGE_ROOTFS_MAXSIZE = "4000000"
# =========================================================================
# Machine settings
# =========================================================================
# Define list of devicetree per supported storage

#kernel dtb
KERNEL_DEVICETREE += "myir/myb-stm32mp257x-2GB.dtb \
		      myir/myb-stm32mp257x-2GB-ethswitch.dtb \
		   "

STM32MP_DT_FILES_EMMC   += "myb-stm32mp257x-2GB"
STM32MP_DT_FILES_SDCARD += "myb-stm32mp257x-2GB"

EXTERNAL_DEVICETREE_SDCARD = ""
EXTERNAL_DEVICETREE_SDCARD =+ "myb-stm32mp257x-2GB-ca35tdcid-ostl"

EXTERNAL_DEVICETREE_EMMC = ""
EXTERNAL_DEVICETREE_EMMC =+ "myb-stm32mp257x-2GB-ca35tdcid-ostl"

# =========================================================================
# Machine features
# =========================================================================
MACHINE_FEATURES += "splashscreen"
MACHINE_FEATURES += "watchdog"
MACHINE_FEATURES += "bluetooth"
MACHINE_FEATURES += "wifi"

# GPU
MACHINE_FEATURES += "${@'gpu' if d.getVar('ACCEPT_EULA_'+d.getVar('MACHINE')) == '1' else ''}"
MACHINE_FEATURES += "${@'openvx' if d.getVar('ACCEPT_EULA_'+d.getVar('MACHINE')) == '1' else ''}"
MACHINE_FEATURES += "${@'opencl' if d.getVar('ACCEPT_EULA_'+d.getVar('MACHINE')) == '1' else ''}"
MACHINE_FEATURES += "${@'vulkan' if d.getVar('ACCEPT_EULA_'+d.getVar('MACHINE')) == '1' else ''}"

# M33
MACHINE_FEATURES += "m33copro"

# Bluetooth
BLUETOOTH_LIST += "linux-firmware-addons-bcm43xx"
# Wifi
WIFI_LIST += "linux-firmware-addons-bcm43xx"
# PCIe
PCI_LIST += "linux-firmware-rtl8168"

# activate external dt
EXTERNAL_DT_ENABLED = "1"

# ==========================================================================
# M33 Boards
# ==========================================================================
# Lists of boards/devicetree on which the m33 service MUST be started
M33_BOARDS_START_AT_STARTUP = ""

# supported m33fw board:
#          stm32mp257f-dk
M33FW_BOARDS += "stm32mp257f-dk"

# =========================================================================
# OPTEE
# =========================================================================
# For sdk generation, declare the default board configuration to use.
ST_OPTEE_EXPORT_TA_REF_BOARD:stm32mp2common = "myb-stm32mp257x-2GB.dts"

DISK_DRIVE = "/dev/mmcblk1"
```
